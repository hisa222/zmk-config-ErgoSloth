## boards/shields/ErgoSloth/Kconfig.shield
```kconfig
# Copyright (c) 2020 Pete Johanson
# SPDX-License-Identifier: MIT

config SHIELD_ERGOSLOTH_DONGLE
    def_bool $(shields_list_contains,ErgoSloth_Dongle)

config SHIELD_ERGOSLOTH_RIGHT
    def_bool $(shields_list_contains,ErgoSloth_R)

config SHIELD_ERGOSLOTH_LEFT
    def_bool $(shields_list_contains,ErgoSloth_L)
```

## config/west.yml
```yaml
manifest:
#  defaults:
#   revision: v0.3
  remotes:
    - name: zmkfirmware
      url-base: https://github.com/zmkfirmware
    # Additional modules containing boards/shields/custom code can be listed here as well
    # See https://docs.zephyrproject.org/3.2.0/develop/west/manifest.html#projects
    - name: hisa222
      url-base: https://github.com/hisa222
      
    #- name: prospector
      #url-base: https://github.com/t-ogura

    #- name: carrefinho
      #url-base: https://github.com/carrefinho

    - name: janpfischer
      url-base: https://github.com/janpfischer
      
    - name: ShiniNet
      url-base: https://github.com/ShiniNet
      
    - name: badjeff
      url-base: https://github.com/badjeff

    - name: kot149
      url-base: https://github.com/kot149

    - name: halfdane
      url-base: https://github.com/halfdane

    - name: geeksville
      url-base: https://github.com/geeksville

    - name: ssbb
      url-base: https://github.com/ssbb
  projects:
    - name: zmk-v0.3
      # remote: zmkfirmware
      remote: hisa222
      revision: main
      import: app/west.yml
      
    - name: zmk-pmw3610-driver
      remote: hisa222
      revision: main

    - name: zmk-dongle-screen
      #remote: janpfischer
      remote: hisa222
      revision: main

    #- name: prospector-zmk-module
      #remote: carrefinho
      #revision: main
      
    #- name: prospector-zmk-module
      #remote: prospector
      #remote: hisa222
      #revision: v2.2.1
      #revision: main
      #path: modules/prospector-zmk-module

      # https://github.com/badjeff/zmk-analog-input-driver
    - name: zmk-analog-input-driver
      remote: badjeff
      revision: main
      # https://github.com/kot149/zmk-scroll-snap
    - name: zmk-scroll-snap
      remote: kot149
      revision: v1

    - name: zmk-mouse-gesture
      remote: hisa222
      revision: v1
      #https://github.com/halfdane/zmk-input-gestures?tab=readme-ov-file#installation--usage
    - name: zmk-input-gestures
      remote: halfdane
      revision: main
      #https://github.com/halfdane/zmk-input-processors
    - name: zmk-input-processors
      remote: halfdane
      revision: main
      #https://github.com/halfdane/zmk-input-gestures?tab=readme-ov-file#installation--usage
    - name: cirque-input-module
      remote: geeksville
      revision: main
      #https://github.com/badjeff/zmk-split-peripheral-input-relay
    - name: zmk-split-peripheral-input-relay
      #remote: hisa222
      remote: badjeff
      revision: main
      #https://github.com/ssbb/zmk-listeners
    - name: zmk-listeners
      remote: ssbb
      revision: v1
  self:
    path: config
```
