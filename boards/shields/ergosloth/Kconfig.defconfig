## boards/shields/ergosloth/Kconfig.defconfig
```kconfig
if SHIELD_ERGOSLOTH_RIGHT

config ZMK_KEYBOARD_NAME
    default "Ergosloth"

config ZMK_SPLIT_ROLE_CENTRAL
    default y

config ZMK_SPLIT_BLE_CENTRAL_PERIPHERALS
    default 1

# Max pair + 1 (+1 for peripheral)
config BT_MAX_CONN
    default 6

# Set this to the same number as BT_MAX_CONN
config BT_MAX_PAIRED
    default 6

endif

if SHIELD_ERGOSLOTH_LEFT 
config ZMK_SPLIT_ROLE_CENTRAL
    default n

config SPI
    default y

endif

if SHIELD_ERGOSLOTH_LEFT || SHIELD_ERGOSLOTH_RIGHT

config ZMK_SPLIT
    default y

config ZMK_POINTING
    default y
    
endif
```

## boards/shields/sp_et6/Kconfig.shield
```kconfig
# Copyright (c) 2020 Pete Johanson
# SPDX-License-Identifier: MIT

config SHIELD_ERGOSLOTH_LEFT
    def_bool $(shields_list_contains,ergosloth_left)

config SHIELD_ERGOSLOTH_RIGHT
    def_bool $(shields_list_contains,ergosloth_right)
```
